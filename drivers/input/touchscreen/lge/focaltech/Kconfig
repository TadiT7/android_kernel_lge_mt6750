## drivers/input/touchscreen/lge/focaltech/Kconfig
```kconfig
#
# LGE touch core configuration
#
if INPUT_TOUCHSCREEN

source "drivers/input/touchscreen/lge/focaltech/FT8006M/Kconfig"
source "drivers/input/touchscreen/lge/focaltech/FT5526/Kconfig"

endif
```

## drivers/input/touchscreen/lge/lgsic/Kconfig
```kconfig
#
# LGE touch core configuration
#
if INPUT_TOUCHSCREEN

source "drivers/input/touchscreen/lge/lgsic/LG4894/Kconfig"
source "drivers/input/touchscreen/lge/lgsic/LG4945/Kconfig"
source "drivers/input/touchscreen/lge/lgsic/LG4946/Kconfig"

endif
```

## drivers/input/touchscreen/lge/lgsic/LG4894/Kconfig
```kconfig
#
# LGE touch core configuration
#
if INPUT_TOUCHSCREEN

menuconfig LGE_TOUCH_LG4894
	bool "LGE Touch Core ODM Device Driver - LG4894"
	depends on LGE_TOUCH_CORE_BASE
	help
	  If your device is lg4894, say Y

# To Do : LGSIC Chipseet
endif
```

## drivers/input/touchscreen/lge/lgsic/LG4945/Kconfig
```kconfig
#
# LGE touch core configuration
#
if INPUT_TOUCHSCREEN

menuconfig LGE_TOUCH_LGSIC_LG4945
	bool "LGE Touch Core ODM Device Driver - LG4945"
	depends on LGE_TOUCH_CORE_BASE
	help
	  If your device is lg4945, say Y

# To Do : LGSIC Chipseet
endif
```

## drivers/misc/mediatek/accelerometer/lsm6dse-acc/Kconfig
```kconfig
config MTK_LSM6DSE_ACC
	bool "MTK_LSM6DSE for MediaTek package"
	default n
	help
	  It support different accelerometer sensor.
          If this option is set,
	  it will support
          MTK_LSM6DSE Accelerometer.
```

## drivers/misc/mediatek/alsps/mn257x/Kconfig
```kconfig
config MTK_MN257X
	bool "mn257x for MediaTek package"
	default n
	help
	It support different type sensor
	in this platform. If this option
	is set, it will support ambient
	and light sensor MN257x.
```

## drivers/misc/mediatek/alsps/rpr0521/Kconfig
```kconfig
config MTK_ROHM_RPR0521
	bool "rpr0521 for MediaTek package"
	default n
	help
	It support different type sensor
	in this platform. If this option
	is set, it will support ambient
	and light sensor RPR0521.
```

## drivers/misc/mediatek/chargepump/Kconfig
```kconfig
config	CUSTOM_KERNEL_CHARGEPUMP
	bool "chargepump Support"
	default n
	help
	  This feature Option is used for projects which using exteranl backlight driver
	  if you want to  external backlight driver, please turn on this feature first,
	  then LED driver call external backlight driver API.
	  Also this feature related to flashlight and DSV driver.

config LEDS_RT4832
	bool "RT4832 Support"
	default n
	help
	  charge pump driver for external backlight and flashlight
	  it support DSV, flashlight, LED module.
	  if you want to use external backlight driver moulde on your project,
	  please turn on chargepump option also.

config LEDS_RT4832_LV5
	bool "RT4832 Support"
	default n
	help
	  charge pump driver for external backlight and flashlight
	  it support DSV, flashlight, LED module.
	  if you want to use external backlight driver moulde on your project,
	  please turn on chargepump option also.

config LEDS_LM3632_LV5
	bool "LM3632 Support"
	default n
	help
	  charge pump driver for external backlight and flashlight
	  it support DSV, flashlight, LED module.
	  if you want to use external backlight driver moulde on your project,
	  please turn on chargepump option also.

config LEDS_RT4832_SF3
	bool "RT4832 Support"
	default n
	help
	  charge pump driver for external backlight and flashlight
	  it support DSV, flashlight, LED module.
	  if you want to use external backlight driver moulde on your project,
	  please turn on chargepump option also.

config LEDS_RT4832_K6PNA
	bool "RT4832 ph1 Support"
	default n
	help
	  charge pump driver for external backlight and flashlight
	  it support DSV, flashlight, LED module.
	  if you want to use external backlight driver moulde on your project,
	  please turn on chargepump option also.

config LEDS_RT4832_PH1
	bool "RT4832 ph1 Support"
	default n
	help
	  charge pump driver for external backlight and flashlight
	  it support DSV, flashlight, LED module.
	  if you want to use external backlight driver moulde on your project,
	  please turn on chargepump option also.

config LEDS_RT4832_CV1
	bool "RT4832 Support"
	default n
	help
	  charge pump driver for external backlight and flashlight
	  it support DSV, flashlight, LED module.
	  if you want to use external backlight driver moulde on your project,
	  please turn on chargepump option also.

config LEDS_DW8767_CV1
	bool "DW8767 Support"
	default n
	help
	  charge pump driver for external backlight and flashlight
	  it support DSV, flashlight, LED module.
	  if you want to use external backlight driver moulde on your project,
	  please turn on chargepump option also.

config LGD_INCELL_LG4894_HD_K6PNA
	bool "LG4894_LV5 Support"
	default n
	help
	  charge pump driver for external backlight and flashlight
	  it support DSV, flashlight, LED module.
	  if you want to use external backlight driver moulde on your project,
	  please turn on chargepump option also.

config LGD_INCELL_LG4894_HD_LV5
	bool "LG4894_LV5 Support"
	default n
	help
	  charge pump driver for external backlight and flashlight
	  it support DSV, flashlight, LED module.
	  if you want to use external backlight driver moulde on your project,
	  please turn on chargepump option also.

config LGD_INCELL_TD4100_HD_SF3
	bool "TD4100_SF3 Support"
	default n
	help
	  charge pump driver for external backlight and flashlight
	  it support DSV, flashlight, LED module.
	  if you want to use external backlight driver moulde on your project,
	  please turn on chargepump option also.

config TOVIS_INCELL_TD4100_HD_LV7
	bool "TD4100_HD_LV7 Support"
	default n
	help
	  charge pump driver for external backlight and flashlight
	  it support DSV, flashlight, LED module.
	  if you want to use external backlight driver moulde on your project,
	  please turn on chargepump option also.

config TOVIS_INCELL_TD4100_HD_LS7
        bool "TD4100_HD_LS7 Support"
        default n
        help
          charge pump driver for external backlight and flashlight
          it support DSV, flashlight, LED module.
          if you want to use external backlight driver moulde on your project,
          please turn on chargepump option also.

config LEDS_RT8542
	bool "RT8542 Support"
	default n
	help
	  charge pump driver for external backlight and flashlight
	  it support DSV, flashlight, LED module.
	  if you want to use external backlight driver moulde on your project,
	  please turn on chargepump option also.

config DSV_SM5107
	bool "SM5107 Support"
	default n
	help
	  charge pump driver for external backlight and flashlight
	  it support DSV, flashlight, LED module.
	  if you want to use external backlight driver moulde on your project,
	  please turn on chargepump option also.

config LGE_DSV_SM5109
	bool "SM5109 Support"
	default n
	help
	  charge pump driver for dsv chip
	  it support DSV only.

config LEDS_LM3648
	bool "LM3648 LED"
	default n
config LEDS_DW8767
	bool "DW8767 Support"
	default n
	help
	  charge pump driver for external backlight and flashlight
	  it support DSV, flashlight, LED module.
	  if you want to use external backlight driver moulde on your project,
	  please turn on chargepump option also.
```

## drivers/misc/mediatek/lcm/Kconfig
```kconfig
config MTK_LCM
	bool CONFIG_MTK_LCM
	default n
	help
	  LCM driver

config CUSTOM_KERNEL_LCM
	string "CUSTOM_KERNEL_LCM"
	help
	  To choose kernel LCM driver name

config MTK_LCM_DEVICE_TREE_SUPPORT
	bool "MTK_LCM_DEVICE_TREE_SUPPORT"
	help
	  Decide whether to support LCM device tree based configuration.
	  This feature requires the connection between display driver and LCM devices.
	  Please also turn on MTK_LCM_DEVICE_TREE_SUPPORT in ProjectConfig.mk.

config LGE_LCM_KD_HX8394A_TH8
        bool "Enable King Display HX8394-A WXGA panel for TH8"
        default n

config LGE_USE_PANEL_DUALIZATION
        bool "Use lge panel id to distinguish panel"
        default n

source "drivers/misc/mediatek/lcm/td4100_hd720_dsi_vdo_tovis_lv7/Kconfig"
source "drivers/misc/mediatek/lcm/ft8006m_hd720_dsi_vdo_tcl_cv1/Kconfig"
source "drivers/misc/mediatek/lcm/lg4894_hd720_dsi_vdo_tovis_cv3/Kconfig"
```

## drivers/misc/mediatek/lcm/lg4894_hd720_dsi_vdo_tovis_cv3/Kconfig
```kconfig
config TOVIS_INCELL_LG4894_HD_CV3
    bool "Enable TOVIS LG4894 INCELL HD panel for CV3"
    default n
```

## drivers/misc/mediatek/lcm/td4100_hd720_dsi_vdo_lgd_sf3/Kconfig
```kconfig
config LGD_INCELL_TD4100_HD_SF3
        bool "Enable LGD TD4100 INCELL HD panel for SF3"
        default n
```

## drivers/misc/mediatek/lcm/td4100_hd720_dsi_vdo_tovis_cv1/Kconfig
```kconfig
config TOVIS_INCELL_TD4100_HD_CV1_SPR
	bool "Enable TOVIS TD4100 INCELL HD panel for LV7_SPR"
	default n
	help
		TOVIS TD4100 INCELL HD panel for CV1_SPR
```

## drivers/misc/mediatek/magnetometer/ak0991x/Kconfig
```kconfig
config MTK_AK0991X
	bool "AKM0991X for MediaTek package"
	default n
	help
	  It support different magnetometer sensor.
          If this option is set,
	  it will support
          AKMD09918 magnetometer.
```

## drivers/misc/mediatek/magnetometer/bmm150/Kconfig
```kconfig
config MTK_BMM150
	bool "BMM150 for MediaTek package"
	default n
	help
	  It support different magnetometer sensor.
          If this option is set,
	  it will support
          BMM150 magnetometer in BMC150.
```

## drivers/misc/mediatek/tc1_interface/vib_drv/Kconfig
```kconfig
config MTK_SM100
    tristate "SM100 Vibrator driver"
    default n
	---help---
	Vibrator driver support for SM100.
	You can customize the vibrate strength and lowest vibrate time.
	If you want to use SM100 Vibrator driver, say Y or M here.
	If unsure, say N.
```

## drivers/power/mediatek/Kconfig.lge
```kconfig
config LGE_PM_EXTERNAL_CHARGER_SUPPORT
	bool "Common MTK external battery charger interface for LG Electronics"
	depends on LGE_PM
	default n
	help
	  Say Y to include support for External Battery Charger IC

if LGE_PM_EXTERNAL_CHARGER_SUPPORT

config LGE_PM_EXTERNAL_CHARGER_BQ24262_SUPPORT
	bool "BQ24262 External Battery Charger for LG Electronics"
	default n
	help
	  Support bq24262 Charger.
	  Say Y to include support for
	  BQ24296 Charger IC.
	  Say N to disable it.

config LGE_PM_EXTERNAL_CHARGER_BQ24296_SUPPORT
	bool "BQ24296 External Battery Charger for LG Electronics"
	default n
	help
	  Support bq24296 Charger.
	  Say Y to include support for
	  BQ24296 Charger IC.
	  Say N to disable it.

config LGE_PM_EXTERNAL_CHARGER_RT9460_SUPPORT
	bool "RT9460 External Battery Charger for LG Electronics"
	default n
	help
	  Say Y to include support for RT9460 Charger IC

config LGE_PM_EXTERNAL_CHARGER_RT9460_SUPPORT_DUMP_REGISTER
	bool "RT9460 register dump"
	depends on LGE_PM_EXTERNAL_CHARGER_RT9460_SUPPORT
	default n
	help
	  Say Y to dump rt9460 register

config LGE_PM_EXTERNAL_CHARGER_RT9460_NOISE_WA
	bool "RT9460 noise WA"
	depends on LGE_PM_EXTERNAL_CHARGER_RT9460_SUPPORT
	default n
	help
	  Say Y to remove audio noise issue on low battery

config LGE_PM_EXTERNAL_CHARGER_SM5424_SUPPORT
	bool "SM5424 External Battery Charger for LG Electronics"
	default n
	help
	  Say Y to include support for SM5424 Charger IC

config LGE_PM_EXTERNAL_CHARGER_BQ25898S_SLAVE_SUPPORT
	bool "BQ25898S External Battery Charger for LG Electronics"
	depends on LGE_PM_EXTERNAL_CHARGER_SM5424_SUPPORT
	default n
	help
	  Say Y to include support for BQ25898S Charger IC

config LGE_PM_EXTERNAL_CHARGER_BQ25601_SUPPORT
	bool "TI BQ25601 external battery charger support"
	default n
	help
	  Say Y to include support for TI BQ25601 Charger IC

config LGE_PM_EXTERNAL_CHARGER_FAN54005_SUPPORT
	bool "FC FAN54005 external battery charger support"
	default n
	help
	  Say Y to include support for FairChild FAN54005 Charger IC

endif # LGE_PM_EXTERNAL_CHARGER_SUPPORT

if LGE_PM

config LGE_PM_BATTERY_OCV_COMPENSATE
    bool "This is to enable LGE supports to battery ocv compensation"
    default n
    help
	  Say Y to support battery ocv compensation

config LGE_PM_BATTERY_PRESENT
	bool "battery present monitoring support"
	default n
	help
	  Say Y to include support for BATTERY PRESENT

config LGE_PM_EXTERNAL_CHARGER_SAFETY_TIMER_SUPPORT
	tristate "External charger can support safety timer"
	default n
	help
	  Say Y when external charger support safety timer

config LGE_PM_TEMP_BY_CHG
	bool "This is to enable Temperature compensation when Fast Charging"
	default n
	help
	  Say Y to enable temperature compensation support

config LGE_PM_CHARGER_CONTROLLER
	bool "LG Electronics charging scenario support"
	default n
	help
	  Say Y to enable charger-controller

config LGE_PM_FLOATED_CHARGER_DETECT
	bool "Floated charger detect"
	default n
	help
	  Say Y to enable floated charger detect

config LGE_PM_LLK_MODE
	bool "restrict charging due to the battery level for demo in store"
	depends on LGE_PM_CHARGER_CONTROLLER
	default n
	help
	  Restrict charging based on battery level

config LGE_PM_CHARGE_INFO
	bool "Logging battery status to kmsg"
	depends on LGE_PM_CHARGER_CONTROLLER
	default n
	help
	  monitor battery status and print log in kmsg.

config LGE_PM_CHARGE_SCENARIO_OTP
	bool "Battery charge scenario for over temperature protection"
	depends on LGE_PM_CHARGER_CONTROLLER
	default n
	help
	  LGE common battery charge protection scenario for over temperature.

config LGE_PM_CHARGE_SCENARIO_THERMAL
	bool "Battery charge scenario for cooling device"
	depends on LGE_PM_CHARGER_CONTROLLER
	default n
	help
	  limit battery charge current to cool device.

config LGE_PM_CHARGE_SCENARIO_FB
	bool "Battery charge scenario for dispaly on/off"
	depends on LGE_PM_CHARGER_CONTROLLER
	default n
	help
	  limit battery charge current by display on/off.

config LGE_PM_CHARGE_SCENARIO_CALL
	bool "Battery charge scenario for call"
	depends on LGE_PM_CHARGER_CONTROLLER
	default n
	help
	  limit battery charge current for call quality.

config LGE_PM_CHARGE_SAFETY_TIMER
	bool "Battery charge scenario for safety timer"
	depends on LGE_PM_CHARGER_CONTROLLER
	default n
	help
	  limit battery charge when charge time is too long.

config LGE_PM_CHARGE_SCENARIO_SPEC
	bool "Battery charge scenario for battery specification"
	depends on LGE_PM_CHARGER_CONTROLLER
	default n
	help
	  limit battery charge current by specification.

config LGE_PM_MTK_POWERTOP
	bool "This is applied due to support power-top.lge"
	default n
	help
	  support power-top.lge

config LGE_PM_MTK_SAVE_BATTERY_CYCLE_GM_2_0
	bool "This is applied due to battery cycle debugging"
	default n
	help
	  support save battery cycle

config LGE_PM_MTK_CANCUN_GOV
	bool "This is applied due to porting cancun governor for mt6750"
	default n
	help
	  cancun governor

config LGE_PM_MTK_GAME_MODE
	bool "This is applied due to support game mode for mt6750"
	default n
	help
	  this feature is for game auto mode. if set, cpu freq.(or core) will
	  be limited for user safety.

config LGE_PM_THERMAL_UPPER_THRE
	bool "This is applied to restrict only in game mode for mt6750"
	default n
	help
	  this feature is for game bcct mode. if set, charging current will
	  be limited only in game mode.
endif # LGE_PM
```
