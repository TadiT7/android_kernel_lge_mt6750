/*
 * LG Electronics akm09916 sensor device tree source
 *
 * Copyright (c) 2016 LG Electronics Co., Ltd.
 *              http://www.lge.com
 *
 */

cust_mag@c {
    compatible = "mediatek,akm09916";
    reg = <0x0c>;
    status = "okay";
    i2c_num = <1>;
    i2c_addr = <0x0c 0 0 0>;
    direction = <1>;
    power_id = <0xffff>;
    power_vol = <0>;
    is_batch_supported = <0>;
};
