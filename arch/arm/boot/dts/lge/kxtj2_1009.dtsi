/*
 * LG Electronics kxtj2_1009 sensor device tree source
 *
 * Copyright (c) 2016 LG Electronics Co., Ltd.
 *              http://www.lge.com
 *
 */

cust_accel@f {
    compatible = "mediatek,kxtj2_1009";
    reg = <0x0f>;
    status = "okay";
    i2c_num = <1>;
    i2c_addr = <0x0f 0 0 0>;
    direction = <6>;
    power_id = <0xffff>;
    power_vol = <0>;
    firlen = <16>;
    is_batch_supported = <0>;
};
