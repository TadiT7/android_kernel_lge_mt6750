/*
 * LG Electronics MN257x alsps device tree source
 *
 * Copyright (c) 2017 LG Electronics Co., Ltd.
 *              http://www.lge.com
 *
 */

cust_alsps@49 {
	compatible = "mediatek,mn257x";
	reg = <0x49>;
	status = "okay";
	i2c_num = <3>;
	i2c_addr= <0x49 0 0 0>;
	power_id = <0xffff>;
	power_vol = <0>;
	polling_mode_ps = <0>;
	polling_mode_als = <0>;
	// als_level = tunable value x 12
	als_level = <0 0 0 0 0 0 0 0 0 0 0 0 0 0 0>;
	// als_value = tunable value x 13
	als_value = <0 0 0 0 0 0 0 0 0 0 0 0 0 0 0 0>; // unused
	ps_threshold_high = <0x14f>;		//default 0x14f: 500
	ps_threshold_low = <0x64>;			//default 0x64: 100
	is_batch_supported_ps = <0>;
	is_batch_supported_als = <0>;
	ps_default_thd_h = <750>;			//default
	ps_default_thd_l = <500>;			//default
	ps_enh_gain = <0x0>; //1X:0x2; 1.5X:0x0
	ps_ct= <0x0>;						//default 0x0: 0
	ps_offset = <0x5a>;
	ps_hystersis = <0xc9>;
	lux_per_count = <0x226>;			//default 0x1e0: 480
	wait_time = <0x8>;					//0x8: 50ms
	ps_wait_time = <0xa>;				//0xa: 100ms
	als_intt = <0xa>;					//0xa: 1024us
	als_gain = <0x3>;					//0x3: Low gain
	als_filter = <0x4>;					//0x4: 16cycle
	als_persist = <0x0>;				//0x0: 1 times
	als_intr_thd_offset = <0x1f4>;		//default 0x14f: 500
	als_low_lux_offset = <0x208>;       //default 4lux
	als_report_type = <0x2>; 			//0:RAW, 1:LPC, 2:dyn_intt
	als_dyn_intt_0 = <0xa>; 			//0xa: 1024us
	als_dyn_intt_gain_0 = <0x1>; 		//0x1: mid gain
	als_dyn_intt_1 = <0x7>; 			//0x7: 257us
	als_dyn_intt_gain_1 = <0x3>; 		//0x3: Low gain
	als_scale_gain = <0x14d>; 			//default 0x14d: 333
	als_offset_gain = <0x1f4>; 			//default 0x1f4:500
	ps_intt = <0xa>; 					//0x8: 256us
	ps_gain = <0x1>; 					//0x1: mid gain
	ps_filter = <0x1>; 					//0x1: 2cycle
	ps_ir_drive = <0x2>; 				//100mA:0x1; 50mA:0x2
	ps_persist = <0x0>; 				//0xx0:1 times
	ps_self_test_max_ct = <0x1f4>; 		//default 0x7d0 2000
};
