/*
 * LG Electronics CV3 nfc device tree source
 *
 * Copyright (c) 2017 LG Electronics Co., Ltd.
 *              http://www.lge.com
 *
 */

&i2c3 {
	pn547@28 {
		compatible = "nxp,pn547";
		reg = <0x28>;
		status = "okay";

		interrupt-parent = <&eintc>;
		interrupts = <13 IRQ_TYPE_EDGE_RISING>;//<PINMUX_GPIO13__FUNC_GPIO13 IRQ_TYPE_EDGE_RISING>;
		debounce = <13 0>;

		nxp,gpio_ven = <15>;//<PINMUX_GPIO15__FUNC_GPIO15>;
		nxp,gpio_mode = <27>;//<PINMUX_GPIO14__FUNC_GPIO14>;
		nxp,gpio_irq = <13>;//<PINMUX_GPIO13__FUNC_GPIO13>;
	};
};
