/*
 * LG Electronics EPL259x alsps device tree source
 *
 * Copyright (c) 2017 LG Electronics Co., Ltd.
 *              http://www.lge.com
 *
 */

cust_alsps@49 {
	compatible = "mediatek,epl259x";
	reg = <0x49>;
	status = "okay";
	i2c_num = <3>;
	i2c_addr= <0x49 0 0 0>;
	power_id = <0xffff>;
	power_vol = <0>;
	polling_mode_ps = <0>;
	polling_mode_als = <1>;
	// als_level = tunable value x 12
	als_level = <7 43 81 122 192 268 457 576 737 929 1245 1506 2349 3166 5450  9733 10303 13410>;
	// als_value = tunable value x 13
	als_value = <0 30 60 90  150 200 350 450 550 720  950 1100 1500 2000 3500  5600  6700  8700 10000>; //unused
	ps_threshold_high = <6900>;
	ps_threshold_low = <3400>;
	is_batch_supported_ps = <0>;
	is_batch_supported_als = <0>;
};
